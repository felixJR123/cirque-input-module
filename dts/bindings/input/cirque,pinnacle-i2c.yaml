## dts/bindings/input/cirque,pinnacle-i2c.yaml
```yaml
description: |
  Sensor driver for the Cirque Pinnacle trackpad ASICs, using the I2C interface

compatible: "cirque,pinnacle-custom"

include: ["i2c-device.yaml", "cirque,pinnacle-common.yaml"]
```

## dts/bindings/input/cirque,pinnacle-spi.yaml
```yaml
description: |
  Sensor driver for the Cirque Pinnacle trackpad ASICs, using the SPI interface

compatible: "cirque,pinnacle-custom"

include: ["spi-device.yaml", "cirque,pinnacle-common.yaml"]
```
